/*
 * MAX7219Driver.c
 *
 *  Created on: Mar 23, 2026
 *      Author: andleo
 */
#include "stm32l4xx_hal.h"
#include "MAX7219Driver.h"
#include "main.h"

#define MAX_ROW 8
#define NUM_MATRIX 4
#define CHAR_MAX 40
#define NOOP 0x00

extern SPI_HandleTypeDef hspi1;

uint8_t InitCommands[5][2] = {
		{0x09, 0x00}, //decode mode -> 0
		{0x0A, 0x03}, //intensity
		{0x0B, 0x07}, //scan all
		{0x0F, 0x00}, //test off
		{0x0C, 0x01}, //normal operation
};

uint8_t LETTERS[CHAR_MAX][8]={
		{0x00,0x08,0x14,0x14,0x14,0x14,0x08,0x00},/*0*/
		{0x00,0x1C,0x08,0x08,0x08,0x0C,0x08,0x00},/*1*/
		{0x00,0x3C,0x04,0x18,0x20,0x20,0x1C,0x00},/*2*/
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		{0x66,0x5A,0x42,0xCF,0xD1,0xCF,0x42,0x3C}, /*little guy*/
};

void Matrix_Clear(void) {
	for (int row = 1; row <= MAX_ROW; row++) {
		uint8_t clearCommand[2] = {row, 0x00};
		HAL_GPIO_WritePin(CS_GPIO_Port,CS_Pin, GPIO_PIN_RESET);
		for (int matrix = 0; matrix < NUM_MATRIX; matrix++) {
			HAL_SPI_Transmit(&hspi1, clearCommand ,2, 1000);
		}
		HAL_GPIO_WritePin(CS_GPIO_Port,CS_Pin, GPIO_PIN_SET);
	}
}

void Matrix_Clear_Cell(int matrix_num){
	uint8_t data[8];
		for (int row = 1; row <= MAX_ROW; row++) {
			for (int matrix = 0; matrix < NUM_MATRIX; matrix++) {
					if (matrix == matrix_num) {
						data[2*matrix + 0] = row;
						data[2*matrix + 1] = 0x00;
					} else {
						data[2*matrix + 0] = NOOP;
					}
			 }
			HAL_GPIO_WritePin(CS_GPIO_Port,CS_Pin, GPIO_PIN_RESET);
			HAL_SPI_Transmit(&hspi1, data ,8, 1000);
			HAL_GPIO_WritePin(CS_GPIO_Port,CS_Pin, GPIO_PIN_SET);
		}
}

void Matrix_Init(void) {
	Matrix_Clear();
	for(int command = 0; command < 5; command++) {
		HAL_GPIO_WritePin(CS_GPIO_Port,CS_Pin, GPIO_PIN_RESET);
		for (int matrix = 0; matrix < NUM_MATRIX; matrix++) {
			HAL_SPI_Transmit(&hspi1, InitCommands[command] ,2, 1000);
		}
		HAL_GPIO_WritePin(CS_GPIO_Port,CS_Pin, GPIO_PIN_SET);
	}
}

void Write_Char(int matrix_num, int char_num) {
	uint8_t charData[8];
	for (int row = 1; row <= MAX_ROW; row++) {
		for (int matrix = 0; matrix < NUM_MATRIX; matrix++) {
				if (matrix == matrix_num) {
					charData[2*matrix + 0] = row;
					charData[2*matrix + 1] = LETTERS[char_num][row-1];
				} else {
					charData[2*matrix + 0] = NOOP;
				}
		 }
		HAL_GPIO_WritePin(CS_GPIO_Port,CS_Pin, GPIO_PIN_RESET);
		HAL_SPI_Transmit(&hspi1, charData ,8, 1000);
		HAL_GPIO_WritePin(CS_GPIO_Port,CS_Pin, GPIO_PIN_SET);
	}
}

void Write_Pixel(int matrix_num, int row_num, int col){
    uint8_t data[8];

    for (int row = 1; row <= MAX_ROW; row++){
        for( int matrix = 0; matrix < NUM_MATRIX; matrix++){
            if (matrix == matrix_num && row == row_num){
                data[2*matrix] = row+1;
                data[2*matrix + 1] = 1 << col;
            }else{
                data[2*matrix] = NOOP;
            }
        }
		HAL_GPIO_WritePin(CS_GPIO_Port,CS_Pin, GPIO_PIN_RESET);
		HAL_SPI_Transmit(&hspi1, data ,8, 1000);
		HAL_GPIO_WritePin(CS_GPIO_Port,CS_Pin, GPIO_PIN_SET);
    }
}


void Six_Seven(int iterations) {
	for (int i = 0; i < iterations; i++) {
		for (int mat = 3; mat >= 1; mat--) {
				Write_Char(mat, 6);
				Write_Char(mat - 1, 7);
				HAL_Delay(250);
				Matrix_Clear();
			}
		Write_Char(0, 6);
		Write_Char(3, 7);
		HAL_Delay(250);
		Matrix_Clear();
	}
}
